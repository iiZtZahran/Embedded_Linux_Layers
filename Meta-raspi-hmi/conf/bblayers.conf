## Meta-raspi-hmi/conf/bblayers.conf
```bitbake
BBLAYERS ?= " \
  /home/zahran/Desktop/YOCTO/poky/meta \
  /home/zahran/Desktop/YOCTO/poky/meta-poky \
  /home/zahran/Desktop/YOCTO/poky/meta-yocto-bsp \
  /home/zahran/Desktop/YOCTO/poky/meta-raspberrypi \
  /home/zahran/Desktop/YOCTO/poky/meta-openembedded/meta-oe \
  /home/zahran/Desktop/YOCTO/poky/meta-qt5 \
  /home/zahran/Desktop/YOCTO/poky/meta-IVI \
  /home/zahran/Desktop/YOCTO/poky/meta-openembedded/meta-python \
  /home/zahran/Desktop/YOCTO/poky/meta-openembedded/meta-networking \
  /home/zahran/Desktop/YOCTO/poky/raspi-hmi \
  "
```

## Meta-raspi-hmi/conf/layer.conf
```bitbake
# We have a conf and classes directory, add to BBPATH
BBPATH .= ":${LAYERDIR}"

# We have recipes-* directories, add to BBFILES
BBFILES += "${LAYERDIR}/recipes-*/*/*.bb \
            ${LAYERDIR}/recipes-*/*/*.bbappend"

BBFILE_COLLECTIONS += "raspi-hmi"
BBFILE_PATTERN_raspi-hmi = "^${LAYERDIR}/"
BBFILE_PRIORITY_raspi-hmi = "6"

LAYERDEPENDS_raspi-hmi = "core"
LAYERSERIES_COMPAT_raspi-hmi = "kirkstone"
```
